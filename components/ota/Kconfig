## components/ota/Kconfig
```kconfig
menu "GitHub OTA"

config OTA_VERSION_URL
    string "Version file URL (raw text)"
    default ""
    help
        Example:
          https://raw.githubusercontent.com/<user>/<repo>/main/ota/version.txt

config OTA_FIRMWARE_URL
    string "Firmware binary URL"
    default ""
    help
        Example (GitHub Releases):
          https://github.com/<user>/<repo>/releases/latest/download/esp32_touch_lcd_185_echo.bin

config OTA_TIMEOUT_MS
    int "HTTP timeout (ms)"
    default 8000

endmenu
```

## components/wifi/Kconfig
```kconfig
menu "Wi-Fi"

config WIFI_SSID
    string "Wi-Fi SSID"
    default ""

config WIFI_PASSWORD
    string "Wi-Fi Password"
    default ""

config WIFI_MAX_RETRY
    int "Wi-Fi connect retry count"
    default 10

endmenu
```

## sdkconfig.defaults
```kconfig
# Reasonable defaults (ESP32-S3 Touch LCD 1.85)

# Flash
CONFIG_ESPTOOLPY_FLASHSIZE_16MB=y

# Partitions
CONFIG_PARTITION_TABLE_CUSTOM=y
CONFIG_PARTITION_TABLE_CUSTOM_FILENAME="partitions.csv"

# OTA
CONFIG_BOOTLOADER_APP_ROLLBACK_ENABLE=y
CONFIG_APP_ROLLBACK_ENABLE=y
CONFIG_ESP_HTTPS_OTA=y
CONFIG_ESP_HTTPS_OTA_DECRYPT_CB=y
CONFIG_ESP_TLS_USING_MBEDTLS=y
CONFIG_MBEDTLS_CERTIFICATE_BUNDLE=y
CONFIG_ESP_TLS_USE_SECURE_ELEMENT=n

# Wi-Fi
CONFIG_ESP_WIFI_ENABLED=y

# Logging
CONFIG_LOG_DEFAULT_LEVEL_INFO=y
```
